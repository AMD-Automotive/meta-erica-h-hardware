## conf/machine/vek385-isp-2026-1.conf
```bitbake
#@TYPE: Machine
#@NAME: vek385-isp-2026-1
#@DESCRIPTION: Machine configuration for the vek385-isp boards.


BBMULTICONFIG += "vek385-isp-2026-1-cortexr52-1-baremetal vek385-isp-2026-1-microblaze-pmc"
MACHINEOVERRIDES .= ":versal-2ve-2vm-vek385-sdt-seg"

#### Preamble
MACHINEOVERRIDES =. "${@['', 'vek385-isp-2026-1:']['vek385-isp-2026-1' !='${MACHINE}']}"
#### Regular settings follow
TUNEFILE[microblaze-pmc] = "conf/machine/include/vek385-isp-2026-1/microblaze.inc"

# Platform Loader and Manager
PLM_DEPENDS = ""
PLM_MCDEPENDS = "mc::vek385-isp-2026-1-microblaze-pmc:plm-firmware:do_deploy"
PLM_DEPLOY_DIR = "${TMPDIR}-vek385-isp-2026-1-microblaze-pmc/deploy/images/${MACHINE}"

# Set the default (linux) domain device tree
CONFIG_DTFILE_DIR := "${@bb.utils.which(d.getVar('BBPATH'), 'conf/dts/vek385-isp-2026-1')}"
CONFIG_DTFILE ?= "${CONFIG_DTFILE_DIR}/cortexa78-linux.dts"
CONFIG_DTFILE[vardepsexclude] += "CONFIG_DTFILE_DIR"

DTB_FILE_PATH ?= "${RECIPE_SYSROOT}/boot/devicetree/${@os.path.basename(d.getVar('CONFIG_DTFILE').replace('.dts', '.dtb'))}"

# Serial Console Settings
SERIAL_CONSOLES ?= "115200;ttyAMA1"

# Yocto arm-trusted-firmware(TF-A) variables
TFA_CONSOLE ?= "pl011_1"
TFA_BL33_LOAD ?= "0x40000000"

# Yocto OP-TEE variables
OPTEE_CONSOLE ?= "1"

# Yocto u-boot-xlnx variables

# Set DDR Base address for u-boot-xlnx-scr variables
DDR_BASEADDR ?= "0x0"
SKIP_APPEND_BASEADDR ?= "1"

# Yocto KERNEL Variables
UBOOT_ENTRYPOINT ?= "0x20200000"
UBOOT_LOADADDRESS ?= "0x20200000"

# Yocto MACHINE_FEATURES Variable
MACHINE_FEATURES += "vcu2 malig78ae efi"

# Required generic machine inclusion
require conf/machine/versal-2ve-2vm-generic.conf

# QEMU Memory Configuration
QB_MEM = "-machine dynamic-mem=on -device amd-ddr-memory,address=0x800000000,size=0x180000000 -device amd-ddr-memory,address=0x50000000000,size=0x80000000"

# This is an 'SDT' based BSP
XILINX_WITH_ESW = "sdt"

# Original SDT artifacts URL
SDT_URI = "https://mkmartifactory.amd.com/artifactory/SW-AutomotiveDevOps-DEV-LOCAL/ERICA-H/hardware//vek385_ecp_2026_07_30_6222f6f6b3380746701de1804ad50104ffad744d.tar.gz"
SDT_URI[S] = "${WORKDIR}/sdt_artifacts"
SDT_URI[sha256sum] = "b1bab2562e4fe9b12548628f2abd56f8f047aedd9eca34f1b13a193f0336ea3d"

# Set the system device trees
SYSTEM_DTFILE_DEPENDS = "sdt-artifacts"
SYSTEM_DTFILE_DIR = "${RECIPE_SYSROOT}${datadir}/sdt/${MACHINE}"
SYSTEM_DTFILE = "${SYSTEM_DTFILE_DIR}/system-top.dts"

# Load the dynamic machine features
include conf/machine/include/vek385-isp-2026-1/${BB_CURRENT_MC}-features.conf
LIBXIL_CONFIG = "conf/machine/include/vek385-isp-2026-1/${BB_CURRENT_MC}-libxil.conf"

# PDI variables
PDI_PATH_DEPENDS = "sdt-artifacts"
PDI_PATH_DIR = "${RECIPE_SYSROOT}${datadir}/sdt/${MACHINE}"
PDI_PATH = "${PDI_PATH_DIR}/vpl_gen_fixed_boot.pdi"

# Primary Bootmode value
DEFAULT_HW_BOOT_MODE = "8"

# Update bootbin to use proper device tree
BIF_PARTITION_IMAGE[device-tree] = "${DTB_FILE_PATH}"

# Remap boot files to ensure the right device tree is listed first
IMAGE_BOOT_FILES =+ "devicetree/${@os.path.basename(d.getVar('CONFIG_DTFILE').replace('.dts', '.dtb'))}"

#### No additional settings should be after the Postamble
#### Postamble
PACKAGE_EXTRA_ARCHS:append = "${@['', ' vek385_isp_2026_1']['vek385-isp-2026-1' != '${MACHINE}']}"
```

## conf/machine/vek385-isp.conf
```bitbake
#@TYPE: Machine
#@NAME: vek385-isp
#@DESCRIPTION: Machine configuration for the vek385-isp boards.


BBMULTICONFIG += "vek385-isp-cortexr52-1-baremetal vek385-isp-microblaze-pmc"
MACHINEOVERRIDES .= ":versal-2ve-2vm-vek385-sdt-seg"

#### Preamble
MACHINEOVERRIDES =. "${@['', 'vek385-isp:']['vek385-isp' !='${MACHINE}']}"
#### Regular settings follow
TUNEFILE[microblaze-pmc] = "conf/machine/include/vek385-isp/microblaze.inc"

# Platform Loader and Manager
PLM_DEPENDS = ""
PLM_MCDEPENDS = "mc::vek385-isp-microblaze-pmc:plm-firmware:do_deploy"
PLM_DEPLOY_DIR = "${TMPDIR}-vek385-isp-microblaze-pmc/deploy/images/${MACHINE}"

# Set the default (linux) domain device tree
CONFIG_DTFILE_DIR := "${@bb.utils.which(d.getVar('BBPATH'), 'conf/dts/vek385-isp')}"
CONFIG_DTFILE ?= "${CONFIG_DTFILE_DIR}/cortexa78-linux.dts"
CONFIG_DTFILE[vardepsexclude] += "CONFIG_DTFILE_DIR"

# Yocto arm-trusted-firmware(TF-A) variables
TFA_CONSOLE ?= "pl011_1"
TFA_BL33_LOAD ?= "0x40000000"

# Yocto OP-TEE variables
OPTEE_CONSOLE ?= "1"

# Set DDR Base address for u-boot-xlnx-scr variables
DDR_BASEADDR ?= "0x0"
SKIP_APPEND_BASEADDR ?= "1"

# Yocto KERNEL Variables
UBOOT_ENTRYPOINT  ?= "0x20200000"
UBOOT_LOADADDRESS ?= "0x20200000"

# Yocto MACHINE_FEATURES Variable
MACHINE_FEATURES += "vcu2 malig78ae"

# Required generic machine inclusion
require conf/machine/versal-2ve-2vm-generic.conf

# This is an 'SDT' based BSP
XILINX_WITH_ESW = "sdt"

# Original SDT artifacts URL
SDT_URI = "https://mkmartifactory.amd.com/artifactory/SW-AutomotiveDevOps-DEV-LOCAL/ERICA-H/hardware//vek385_ecp_2026_07_24_d9cf8305c510d101b05e0a6c8e961223186d84db.tar.gz"
SDT_URI[S] = "${WORKDIR}/sdt_artifacts"
SDT_URI[sha256sum] = "9f35b22b047c290bebd3fa94f809c3c8fc59281e4dd2d20162593ab63c40786e"

# Set the system device trees
SYSTEM_DTFILE_DEPENDS = "sdt-artifacts"
SYSTEM_DTFILE_DIR = "${RECIPE_SYSROOT}${datadir}/sdt/${MACHINE}"
SYSTEM_DTFILE = "${SYSTEM_DTFILE_DIR}/system-top.dts"

# Load the dynamic machine features
include conf/machine/include/vek385-isp/${BB_CURRENT_MC}-features.conf
LIBXIL_CONFIG = "conf/machine/include/vek385-isp/${BB_CURRENT_MC}-libxil.conf"

# Versal PDI
PDI_PATH_DEPENDS = "sdt-artifacts"
PDI_PATH_DIR = "${RECIPE_SYSROOT}${datadir}/sdt/${MACHINE}"
PDI_PATH = "${PDI_PATH_DIR}/vpl_gen_fixed_boot.pdi"

# Update bootbin to use proper device tree
BIF_PARTITION_IMAGE[device-tree] = "${RECIPE_SYSROOT}/boot/devicetree/${@os.path.basename(d.getVar('CONFIG_DTFILE').replace('.dts', '.dtb'))}"

# Remap boot files to ensure the right device tree is listed first
IMAGE_BOOT_FILES =+ "devicetree/${@os.path.basename(d.getVar('CONFIG_DTFILE').replace('.dts', '.dtb'))}"

#### No additional settings should be after the Postamble
#### Postamble
PACKAGE_EXTRA_ARCHS:append = "${@['', ' vek385_isp']['vek385-isp' != '${MACHINE}']}"
```

## conf/machine/vek385-xylon-sentry.conf
```bitbake
#@TYPE: Machine
#@NAME: vek385-xylon-sentry
#@DESCRIPTION: Machine configuration for the vek385-xylon-sentry boards.


BBMULTICONFIG += "vek385-xylon-sentry-cortexr52-1-baremetal vek385-xylon-sentry-microblaze-pmc"
MACHINEOVERRIDES .= ":versal-2ve-2vm-vek385-sdt-seg"

#### Preamble
MACHINEOVERRIDES =. "${@['', 'vek385-xylon-sentry:']['vek385-xylon-sentry' !='${MACHINE}']}"
#### Regular settings follow
TUNEFILE[microblaze-pmc] = "conf/machine/include/vek385-xylon-sentry/microblaze.inc"

# Platform Loader and Manager
PLM_DEPENDS = ""
PLM_MCDEPENDS = "mc::vek385-xylon-sentry-microblaze-pmc:plm-firmware:do_deploy"
PLM_DEPLOY_DIR = "${TMPDIR}-vek385-xylon-sentry-microblaze-pmc/deploy/images/${MACHINE}"

# Set the default (linux) domain device tree
CONFIG_DTFILE_DIR := "${@bb.utils.which(d.getVar('BBPATH'), 'conf/dts/vek385-xylon-sentry')}"
CONFIG_DTFILE ?= "${CONFIG_DTFILE_DIR}/cortexa78-linux.dts"
CONFIG_DTFILE[vardepsexclude] += "CONFIG_DTFILE_DIR"

DTB_FILE_PATH ?= "${RECIPE_SYSROOT}/boot/devicetree/${@os.path.basename(d.getVar('CONFIG_DTFILE').replace('.dts', '.dtb'))}"

# Serial Console Settings
SERIAL_CONSOLES ?= "115200;ttyAMA0"

# Yocto arm-trusted-firmware(TF-A) variables
TFA_CONSOLE ?= "pl011_1"
TFA_BL33_LOAD ?= "0x40000000"

# Yocto OP-TEE variables
OPTEE_CONSOLE ?= "1"

# Yocto u-boot-xlnx variables

# Set DDR Base address for u-boot-xlnx-scr variables
DDR_BASEADDR ?= "0x0"
SKIP_APPEND_BASEADDR ?= "1"

# Yocto KERNEL Variables
UBOOT_ENTRYPOINT ?= "0x20200000"
UBOOT_LOADADDRESS ?= "0x20200000"

# Yocto MACHINE_FEATURES Variable
MACHINE_FEATURES += "vcu2 malig78ae efi"

# Required generic machine inclusion
require conf/machine/versal-2ve-2vm-generic.conf

# QEMU Memory Configuration
QB_MEM = "-machine dynamic-mem=on -device amd-ddr-memory,address=0x800000000,size=0x80000000"

# This is an 'SDT' based BSP
XILINX_WITH_ESW = "sdt"

# Original SDT artifacts URL
SDT_URI = "https://mkmartifactory.amd.com/artifactory/SW-AutomotiveDevOps-DEV-LOCAL/ERICA-H/hardware/vek385_sentry_xylon_2026_10_20_253238696cdf1b5ad032ffe3cfdb00efdef0cb45.tar.gz"
SDT_URI[S] = "${WORKDIR}/sdt_artifacts"
SDT_URI[sha256sum] = "c01d83bb2199d4cef2afb1b651ae85aa7aabec8e16ad88af834c4da91ff87f00"

# Set the system device trees
SYSTEM_DTFILE_DEPENDS = "sdt-artifacts"
SYSTEM_DTFILE_DIR = "${RECIPE_SYSROOT}${datadir}/sdt/${MACHINE}"
SYSTEM_DTFILE = "${SYSTEM_DTFILE_DIR}/system-top.dts"

# Load the dynamic machine features
include conf/machine/include/vek385-xylon-sentry/${BB_CURRENT_MC}-features.conf
LIBXIL_CONFIG = "conf/machine/include/vek385-xylon-sentry/${BB_CURRENT_MC}-libxil.conf"

# PDI variables
PDI_PATH_DEPENDS = "sdt-artifacts"
PDI_PATH_DIR = "${RECIPE_SYSROOT}${datadir}/sdt/${MACHINE}"
PDI_PATH = "${PDI_PATH_DIR}/vpl_gen_fixed_boot.pdi"

# Primary Bootmode value
DEFAULT_HW_BOOT_MODE = "8"

# Update bootbin to use proper device tree
BIF_PARTITION_IMAGE[device-tree] = "${DTB_FILE_PATH}"

# Remap boot files to ensure the right device tree is listed first
IMAGE_BOOT_FILES =+ "devicetree/${@os.path.basename(d.getVar('CONFIG_DTFILE').replace('.dts', '.dtb'))}"

#### No additional settings should be after the Postamble
#### Postamble
PACKAGE_EXTRA_ARCHS:append = "${@['', ' vek385_xylon_sentry']['vek385-xylon-sentry' != '${MACHINE}']}"
```

## conf/machine/vek385-yuv.conf
```bitbake
#@TYPE: Machine
#@NAME: vek385-yuv
#@DESCRIPTION: Machine configuration for the vek385-yuv boards.


BBMULTICONFIG += "vek385-yuv-cortexr52-1-baremetal vek385-yuv-microblaze-pmc"
MACHINEOVERRIDES .= ":versal-2ve-2vm-vek385-sdt-seg"

#### Preamble
MACHINEOVERRIDES =. "${@['', 'vek385-yuv:']['vek385-yuv' !='${MACHINE}']}"
#### Regular settings follow
TUNEFILE[microblaze-pmc] = "conf/machine/include/vek385-yuv/microblaze.inc"

# Platform Loader and Manager
PLM_DEPENDS = ""
PLM_MCDEPENDS = "mc::vek385-yuv-microblaze-pmc:plm-firmware:do_deploy"
PLM_DEPLOY_DIR = "${TMPDIR}-vek385-yuv-microblaze-pmc/deploy/images/${MACHINE}"

# Set the default (linux) domain device tree
CONFIG_DTFILE_DIR := "${@bb.utils.which(d.getVar('BBPATH'), 'conf/dts/vek385-yuv')}"
CONFIG_DTFILE ?= "${CONFIG_DTFILE_DIR}/cortexa78-linux.dts"
CONFIG_DTFILE[vardepsexclude] += "CONFIG_DTFILE_DIR"

# Yocto arm-trusted-firmware(TF-A) variables
TFA_CONSOLE ?= "pl011_1"
TFA_BL33_LOAD ?= "0x40000000"

# Yocto OP-TEE variables
OPTEE_CONSOLE ?= "1"

# Set DDR Base address for u-boot-xlnx-scr variables
DDR_BASEADDR ?= "0x0"
SKIP_APPEND_BASEADDR ?= "1"

# Yocto KERNEL Variables
UBOOT_ENTRYPOINT  ?= "0x20200000"
UBOOT_LOADADDRESS ?= "0x20200000"

# Yocto MACHINE_FEATURES Variable
MACHINE_FEATURES += "vcu2 malig78ae"

# Required generic machine inclusion
require conf/machine/versal-2ve-2vm-generic.conf

# This is an 'SDT' based BSP
XILINX_WITH_ESW = "sdt"

# Original SDT artifacts URL
SDT_URI = "https://mkmartifactory.amd.com/artifactory/SW-AutomotiveDevOps-DEV-LOCAL/ERICA-H/hardware//vek385_ecp_2026_02_11_322127a3f70f458730504808f76caf3742208643.tar.gz"
SDT_URI[S] = "${WORKDIR}/sdt_artifacts"
SDT_URI[sha256sum] = "3833456e4be463ca70b8189717f07336b168b3def0354f8f62eb21be97a3ff8d"

# Set the system device trees
SYSTEM_DTFILE_DEPENDS = "sdt-artifacts"
SYSTEM_DTFILE_DIR = "${RECIPE_SYSROOT}${datadir}/sdt/${MACHINE}"
SYSTEM_DTFILE = "${SYSTEM_DTFILE_DIR}/system-top.dts"

# Load the dynamic machine features
include conf/machine/include/vek385-yuv/${BB_CURRENT_MC}-features.conf
LIBXIL_CONFIG = "conf/machine/include/vek385-yuv/${BB_CURRENT_MC}-libxil.conf"

# Versal PDI
PDI_PATH_DEPENDS = "sdt-artifacts"
PDI_PATH_DIR = "${RECIPE_SYSROOT}${datadir}/sdt/${MACHINE}"
PDI_PATH = "${PDI_PATH_DIR}/vpl_gen_fixed_boot.pdi"

# Update bootbin to use proper device tree
BIF_PARTITION_IMAGE[device-tree] = "${RECIPE_SYSROOT}/boot/devicetree/${@os.path.basename(d.getVar('CONFIG_DTFILE').replace('.dts', '.dtb'))}"

# Remap boot files to ensure the right device tree is listed first
IMAGE_BOOT_FILES =+ "devicetree/${@os.path.basename(d.getVar('CONFIG_DTFILE').replace('.dts', '.dtb'))}"

#### No additional settings should be after the Postamble
#### Postamble
PACKAGE_EXTRA_ARCHS:append = "${@['', ' vek385_yuv']['vek385-yuv' != '${MACHINE}']}"
```
