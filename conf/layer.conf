## conf/machine/rave2-baseline-2026-1.conf
```bitbake
#@TYPE: Machine
#@NAME: rave2-baseline-2026-1
#@DESCRIPTION: Machine configuration for the rave2-baseline-2026-1 boards.


BBMULTICONFIG += "rave2-baseline-2026-1-microblaze-pmc rave2-baseline-2026-1-microblaze-riscv-asu"

#### Preamble
MACHINEOVERRIDES =. "${@['', 'rave2-baseline-2026-1:']['rave2-baseline-2026-1' !='${MACHINE}']}"
#### Regular settings follow
TUNEFILE[microblaze-pmc] = "conf/machine/include/rave2-baseline-2026-1/microblaze.inc"
TUNEFILE[microblaze-v-asu] = "conf/machine/include/rave2-baseline-2026-1/microblaze-v.inc"

# Platform Loader and Manager
PLM_DEPENDS = ""
PLM_MCDEPENDS = "mc::rave2-baseline-2026-1-microblaze-pmc:plm-firmware:do_deploy"
PLM_DEPLOY_DIR = "${TMPDIR}-rave2-baseline-2026-1-microblaze-pmc/deploy/images/${MACHINE}"

# ASU Firmware
ASU_DEPENDS = ""
ASU_MCDEPENDS = "mc::rave2-baseline-2026-1-microblaze-riscv-asu:asu-firmware:do_deploy"
ASU_DEPLOY_DIR = "${TMPDIR}-rave2-baseline-2026-1-microblaze-riscv-asu/deploy/images/${MACHINE}"

# Set the default (linux) domain device tree
CONFIG_DTFILE_DIR := "${@bb.utils.which(d.getVar('BBPATH'), 'conf/dts/rave2-baseline-2026-1')}"
CONFIG_DTFILE ?= "${CONFIG_DTFILE_DIR}/cortexa78-linux.dts"
CONFIG_DTFILE[vardepsexclude] += "CONFIG_DTFILE_DIR"

DTB_FILE_PATH ?= "${RECIPE_SYSROOT}/boot/devicetree/${@os.path.basename(d.getVar('CONFIG_DTFILE').replace('.dts', '.dtb'))}"

# Serial Console Settings
SERIAL_CONSOLES ?= "115200;ttyAMA0"

# Yocto arm-trusted-firmware(TF-A) variables
TFA_CONSOLE ?= "pl011_1"
TFA_BL33_LOAD ?= "0x40000000"

# Yocto OP-TEE variables
OPTEE_CONSOLE ?= "0"

# Yocto u-boot-xlnx variables

# Set DDR Base address for u-boot-xlnx-scr variables
DDR_BASEADDR ?= "0x0"
SKIP_APPEND_BASEADDR ?= "1"

# Yocto KERNEL Variables
UBOOT_ENTRYPOINT ?= "0x20200000"
UBOOT_LOADADDRESS ?= "0x20200000"

# Yocto MACHINE_FEATURES Variable
MACHINE_FEATURES += "vcu2 malig78ae efi"

# Required generic machine inclusion
require conf/machine/versal-2ve-2vm-generic.conf

# QEMU Memory Configuration
QB_MEM = "-machine dynamic-mem=on -device amd-ddr-memory,address=0x800000000,size=0x380000000"

# This is an 'SDT' based BSP
XILINX_WITH_ESW = "sdt"

# Original SDT artifacts URL
SDT_URI = "https://mkmartifactory.amd.com/artifactory/SW-AutomotiveDevOps-DEV-LOCAL/ERICA-H/hardware/rave2_baseline_2026_09_01_da104f0e618aa3af793862dc793c110453e897f1.tar.gz"
SDT_URI[S] = "${WORKDIR}/sdt_artifacts"
SDT_URI[sha256sum] = "047e72ca74703f0e974003c07dcf3412a15a3da2abd28f08b697928bc8c18735"

# Set the system device trees
SYSTEM_DTFILE_DEPENDS = "sdt-artifacts"
SYSTEM_DTFILE_DIR = "${RECIPE_SYSROOT}${datadir}/sdt/${MACHINE}"
SYSTEM_DTFILE = "${SYSTEM_DTFILE_DIR}/system-top.dts"

# Load the dynamic machine features
include conf/machine/include/rave2-baseline-2026-1/${BB_CURRENT_MC}-features.conf
LIBXIL_CONFIG = "conf/machine/include/rave2-baseline-2026-1/${BB_CURRENT_MC}-libxil.conf"

# PDI variables
PDI_PATH_DEPENDS = "sdt-artifacts"
PDI_PATH_DIR = "${RECIPE_SYSROOT}${datadir}/sdt/${MACHINE}"
PDI_PATH = "${PDI_PATH_DIR}/versal_hexcam_20232_1_boot.pdi"

# Primary Bootmode value
DEFAULT_HW_BOOT_MODE = "8"

# Update bootbin to use proper device tree
BIF_PARTITION_IMAGE[device-tree] = "${DTB_FILE_PATH}"

# Remap boot files to ensure the right device tree is listed first
IMAGE_BOOT_FILES =+ "devicetree/${@os.path.basename(d.getVar('CONFIG_DTFILE').replace('.dts', '.dtb'))}"

#### No additional settings should be after the Postamble
#### Postamble
PACKAGE_EXTRA_ARCHS:append = "${@['', ' rave2_baseline_2026_1']['rave2-baseline-2026-1' != '${MACHINE}']}"
```

## conf/machine/rave2-baseline.conf
```bitbake
#@TYPE: Machine
#@NAME: rave2-baseline
#@DESCRIPTION: Machine configuration for the rave2-baseline boards.


BBMULTICONFIG += "rave2-baseline-microblaze-pmc rave2-baseline-microblaze-riscv-asu"

#### Preamble
MACHINEOVERRIDES =. "${@['', 'rave2-baseline:']['rave2-baseline' !='${MACHINE}']}"
#### Regular settings follow
TUNEFILE[microblaze-pmc] = "conf/machine/include/rave2-baseline/microblaze.inc"
TUNEFILE[microblaze-riscv-asu] = "conf/machine/include/rave2-baseline/microblaze-riscv.inc"

# Platform Loader and Manager
PLM_DEPENDS = ""
PLM_MCDEPENDS = "mc::rave2-baseline-microblaze-pmc:plm-firmware:do_deploy"
PLM_DEPLOY_DIR = "${TMPDIR}-rave2-baseline-microblaze-pmc/deploy/images/${MACHINE}"

# ASU Firware
ASU_DEPENDS = ""
ASU_MCDEPENDS = "mc::rave2-baseline-microblaze-riscv-asu:asu-firmware:do_deploy"
ASU_DEPLOY_DIR = "${TMPDIR}-rave2-baseline-microblaze-riscv-asu/deploy/images/${MACHINE}"

# Set the default (linux) domain device tree
CONFIG_DTFILE_DIR := "${@bb.utils.which(d.getVar('BBPATH'), 'conf/dts/rave2-baseline')}"
CONFIG_DTFILE ?= "${CONFIG_DTFILE_DIR}/cortexa78-linux.dts"
CONFIG_DTFILE[vardepsexclude] += "CONFIG_DTFILE_DIR"

# Yocto arm-trusted-firmware(TF-A) variables
TFA_CONSOLE ?= "pl011_1"
TFA_BL33_LOAD ?= "0x40000000"

# Yocto OP-TEE variables
OPTEE_CONSOLE ?= "0"

# Set DDR Base address for u-boot-xlnx-scr variables
DDR_BASEADDR ?= "0x0"
SKIP_APPEND_BASEADDR ?= "1"

# Yocto KERNEL Variables
UBOOT_ENTRYPOINT  ?= "0x20200000"
UBOOT_LOADADDRESS ?= "0x20200000"

# Yocto MACHINE_FEATURES Variable
MACHINE_FEATURES += "vcu2 malig78ae"

# Required generic machine inclusion
require conf/machine/versal-2ve-2vm-generic.conf

# This is an 'SDT' based BSP
XILINX_WITH_ESW = "sdt"

# Original SDT artifacts URL
SDT_URI = "https://mkmartifactory.amd.com/artifactory/SW-AutomotiveDevOps-DEV-LOCAL/ERICA-H/hardware//rave2_baseline_2026_07_12_362de6e62e4adfa8417f740ca2264a0824833ac8.tar.gz"
SDT_URI[S] = "${WORKDIR}/sdt_artifacts"
SDT_URI[sha256sum] = "0c7b6bd75cdf5aa882013808513b23070b1f89dc0ce2f72075343f710e9c41f0"

# Set the system device trees
SYSTEM_DTFILE_DEPENDS = "sdt-artifacts"
SYSTEM_DTFILE_DIR = "${RECIPE_SYSROOT}${datadir}/sdt/${MACHINE}"
SYSTEM_DTFILE = "${SYSTEM_DTFILE_DIR}/system-top.dts"

# Load the dynamic machine features
include conf/machine/include/rave2-baseline/${BB_CURRENT_MC}-features.conf
LIBXIL_CONFIG = "conf/machine/include/rave2-baseline/${BB_CURRENT_MC}-libxil.conf"

# Versal PDI
PDI_PATH_DEPENDS = "sdt-artifacts"
PDI_PATH_DIR = "${RECIPE_SYSROOT}${datadir}/sdt/${MACHINE}"
PDI_PATH = "${PDI_PATH_DIR}/versal_hexcam_20232_1_boot.pdi"

# Update bootbin to use proper device tree
BIF_PARTITION_IMAGE[device-tree] = "${RECIPE_SYSROOT}/boot/devicetree/${@os.path.basename(d.getVar('CONFIG_DTFILE').replace('.dts', '.dtb'))}"

# Remap boot files to ensure the right device tree is listed first
IMAGE_BOOT_FILES =+ "devicetree/${@os.path.basename(d.getVar('CONFIG_DTFILE').replace('.dts', '.dtb'))}"

#### No additional settings should be after the Postamble
#### Postamble
PACKAGE_EXTRA_ARCHS:append = "${@['', ' rave2_baseline']['rave2-baseline' != '${MACHINE}']}"
```

## conf/machine/rave2-display-expansion.conf
```bitbake
#@TYPE: Machine
#@NAME: rave2-display-expansion
#@DESCRIPTION: Machine configuration for the rave2-display-expansion boards.


BBMULTICONFIG += "rave2-display-expansion-microblaze-pmc rave2-display-expansion-microblaze-riscv-asu"

#### Preamble
MACHINEOVERRIDES =. "${@['', 'rave2-display-expansion:']['rave2-display-expansion' !='${MACHINE}']}"
#### Regular settings follow
TUNEFILE[microblaze-pmc] = "conf/machine/include/rave2-display-expansion/microblaze.inc"
TUNEFILE[microblaze-riscv-asu] = "conf/machine/include/rave2-display-expansion/microblaze-riscv.inc"

# Platform Loader and Manager
PLM_DEPENDS = ""
PLM_MCDEPENDS = "mc::rave2-display-expansion-microblaze-pmc:plm-firmware:do_deploy"
PLM_DEPLOY_DIR = "${TMPDIR}-rave2-display-expansion-microblaze-pmc/deploy/images/${MACHINE}"

# ASU Firware
ASU_DEPENDS = ""
ASU_MCDEPENDS = "mc::rave2-display-expansion-microblaze-riscv-asu:asu-firmware:do_deploy"
ASU_DEPLOY_DIR = "${TMPDIR}-rave2-display-expansion-microblaze-riscv-asu/deploy/images/${MACHINE}"

# Set the default (linux) domain device tree
CONFIG_DTFILE_DIR := "${@bb.utils.which(d.getVar('BBPATH'), 'conf/dts/rave2-display-expansion')}"
CONFIG_DTFILE ?= "${CONFIG_DTFILE_DIR}/cortexa78-linux.dts"
CONFIG_DTFILE[vardepsexclude] += "CONFIG_DTFILE_DIR"

# Yocto arm-trusted-firmware(TF-A) variables
TFA_CONSOLE ?= "pl011_1"
TFA_BL33_LOAD ?= "0x40000000"

# Yocto OP-TEE variables
OPTEE_CONSOLE ?= "0"

# Set DDR Base address for u-boot-xlnx-scr variables
DDR_BASEADDR ?= "0x0"
SKIP_APPEND_BASEADDR ?= "1"

# Yocto KERNEL Variables
UBOOT_ENTRYPOINT  ?= "0x20200000"
UBOOT_LOADADDRESS ?= "0x20200000"

# Yocto MACHINE_FEATURES Variable
MACHINE_FEATURES += "vcu2 malig78ae"

# Required generic machine inclusion
require conf/machine/versal-2ve-2vm-generic.conf

# This is an 'SDT' based BSP
XILINX_WITH_ESW = "sdt"

# Original SDT artifacts URL
SDT_URI = "https://mkmartifactory.amd.com/artifactory/SW-AutomotiveDevOps-DEV-LOCAL/ERICA-H/hardware//rave2_safe_display_2026_05_21_64f8dae478460730d583e3e57b61ace516da1459.tar.gz"
SDT_URI[S] = "${WORKDIR}/sdt_artifacts"
SDT_URI[sha256sum] = "5f577e989fc9652a54ff81b1b69822e0d63cfe04aba574220ad8115925ecdb1b"

# Set the system device trees
SYSTEM_DTFILE_DEPENDS = "sdt-artifacts"
SYSTEM_DTFILE_DIR = "${RECIPE_SYSROOT}${datadir}/sdt/${MACHINE}"
SYSTEM_DTFILE = "${SYSTEM_DTFILE_DIR}/system-top.dts"

# Load the dynamic machine features
include conf/machine/include/rave2-display-expansion/${BB_CURRENT_MC}-features.conf
LIBXIL_CONFIG = "conf/machine/include/rave2-display-expansion/${BB_CURRENT_MC}-libxil.conf"

# Versal PDI
PDI_PATH_DEPENDS = "sdt-artifacts"
PDI_PATH_DIR = "${RECIPE_SYSROOT}${datadir}/sdt/${MACHINE}"
PDI_PATH = "${PDI_PATH_DIR}/versal_hexcam_20232_1_boot.pdi"

# Update bootbin to use proper device tree
BIF_PARTITION_IMAGE[device-tree] = "${RECIPE_SYSROOT}/boot/devicetree/${@os.path.basename(d.getVar('CONFIG_DTFILE').replace('.dts', '.dtb'))}"

# Remap boot files to ensure the right device tree is listed first
IMAGE_BOOT_FILES =+ "devicetree/${@os.path.basename(d.getVar('CONFIG_DTFILE').replace('.dts', '.dtb'))}"

#### No additional settings should be after the Postamble
#### Postamble
PACKAGE_EXTRA_ARCHS:append = "${@['', ' rave2_display_expansion']['rave2-display-expansion' != '${MACHINE}']}"
```

## conf/machine/rave2-ecp.conf
```bitbake
#@TYPE: Machine
#@NAME: rave2-ecp
#@DESCRIPTION: Machine configuration for the rave2-ecp boards.


BBMULTICONFIG += "rave2-ecp-microblaze-pmc rave2-ecp-microblaze-riscv-asu"

#### Preamble
MACHINEOVERRIDES =. "${@['', 'rave2-ecp:']['rave2-ecp' !='${MACHINE}']}"
#### Regular settings follow
TUNEFILE[microblaze-pmc] = "conf/machine/include/rave2-ecp/microblaze.inc"
TUNEFILE[microblaze-riscv-asu] = "conf/machine/include/rave2-ecp/microblaze-riscv.inc"

# Platform Loader and Manager
PLM_DEPENDS = ""
PLM_MCDEPENDS = "mc::rave2-ecp-microblaze-pmc:plm-firmware:do_deploy"
PLM_DEPLOY_DIR = "${TMPDIR}-rave2-ecp-microblaze-pmc/deploy/images/${MACHINE}"

# ASU Firware
ASU_DEPENDS = ""
ASU_MCDEPENDS = "mc::rave2-ecp-microblaze-riscv-asu:asu-firmware:do_deploy"
ASU_DEPLOY_DIR = "${TMPDIR}-rave2-ecp-microblaze-riscv-asu/deploy/images/${MACHINE}"

# Set the default (linux) domain device tree
CONFIG_DTFILE_DIR := "${@bb.utils.which(d.getVar('BBPATH'), 'conf/dts/rave2-ecp')}"
CONFIG_DTFILE ?= "${CONFIG_DTFILE_DIR}/cortexa78-linux.dts"
CONFIG_DTFILE[vardepsexclude] += "CONFIG_DTFILE_DIR"

# Yocto arm-trusted-firmware(TF-A) variables
TFA_CONSOLE ?= "pl011_1"
TFA_BL33_LOAD ?= "0x40000000"

# Yocto OP-TEE variables
OPTEE_CONSOLE ?= "0"

# Set DDR Base address for u-boot-xlnx-scr variables
DDR_BASEADDR ?= "0x0"
SKIP_APPEND_BASEADDR ?= "1"

# Yocto KERNEL Variables
UBOOT_ENTRYPOINT  ?= "0x20200000"
UBOOT_LOADADDRESS ?= "0x20200000"

# Yocto MACHINE_FEATURES Variable
MACHINE_FEATURES += "vcu2 malig78ae"

# Required generic machine inclusion
require conf/machine/versal-2ve-2vm-generic.conf

# This is an 'SDT' based BSP
XILINX_WITH_ESW = "sdt"

# Original SDT artifacts URL
SDT_URI = "https://mkmartifactory.amd.com/artifactory/SW-AutomotiveDevOps-DEV-LOCAL/ERICA-H/hardware/rave2_ecp_2026_08_05_c31551d9015af7003878fe5e24baa1a0a03fcbf3.tar.gz"
SDT_URI[S] = "${WORKDIR}/sdt_artifacts"
SDT_URI[sha256sum] = "6350a607dd3856920b43dc805d6e4566d9a274879e7dc97d2fafa52ee293d945"

# Set the system device trees
SYSTEM_DTFILE_DEPENDS = "sdt-artifacts"
SYSTEM_DTFILE_DIR = "${RECIPE_SYSROOT}${datadir}/sdt/${MACHINE}"
SYSTEM_DTFILE = "${SYSTEM_DTFILE_DIR}/system-top.dts"

# Load the dynamic machine features
include conf/machine/include/rave2-ecp/${BB_CURRENT_MC}-features.conf
LIBXIL_CONFIG = "conf/machine/include/rave2-ecp/${BB_CURRENT_MC}-libxil.conf"

# Versal PDI
PDI_PATH_DEPENDS = "sdt-artifacts"
PDI_PATH_DIR = "${RECIPE_SYSROOT}${datadir}/sdt/${MACHINE}"
PDI_PATH = "${PDI_PATH_DIR}/vpl_gen_fixed_boot.pdi"

# Update bootbin to use proper device tree
BIF_PARTITION_IMAGE[device-tree] = "${RECIPE_SYSROOT}/boot/devicetree/${@os.path.basename(d.getVar('CONFIG_DTFILE').replace('.dts', '.dtb'))}"

# Remap boot files to ensure the right device tree is listed first
IMAGE_BOOT_FILES =+ "devicetree/${@os.path.basename(d.getVar('CONFIG_DTFILE').replace('.dts', '.dtb'))}"

#### No additional settings should be after the Postamble
#### Postamble
PACKAGE_EXTRA_ARCHS:append = "${@['', ' rave2_ecp']['rave2-ecp' != '${MACHINE}']}"
```

## conf/machine/vek280-sv-dms.conf
```bitbake
#@TYPE: Machine
#@NAME: vek-280-surround-view-dms
#@DESCRIPTION: Machine configuration for the vek-280-surround-view-dms board.

#### Preamble
MACHINEOVERRIDES =. "${@['', 'vek-280-surround-view-dms:']['vek-280-surround-view-dms' !='${MACHINE}']}"
#### Regular settings follow

# Yocto device-tree variables
YAML_CONSOLE_DEVICE_CONFIG:pn-device-tree ?= "CIPS_0_pspmc_0_psv_sbsauart_0"
YAML_MAIN_MEMORY_CONFIG:pn-device-tree ?= "C0_DDR_LOW0X2"
DT_PADDING_SIZE:pn-device-tree ?= "0x1000"
DTC_FLAGS:pn-device-tree ?= "-@"
YAML_DT_BOARD_FLAGS ?= "{BOARD template}"

# Yocto u-boot-xlnx variables
UBOOT_MACHINE ?= "xilinx_versal_virt_defconfig"

# Yocto arm-trusted-firmware(TF-A) variables
ATF_CONSOLE_DEFAULT ?= "pl011"
TFA_BL33_LOAD ?= "0x8000000"

# Yocto PLM variables
YAML_SERIAL_CONSOLE_STDIN:pn-plm-firmware ?= "CIPS_0_pspmc_0_psv_sbsauart_0"
YAML_SERIAL_CONSOLE_STDOUT:pn-plm-firmware ?= "CIPS_0_pspmc_0_psv_sbsauart_0"

# Yocto KERNEL Variables
UBOOT_ENTRYPOINT  ?= "0x200000"
UBOOT_LOADADDRESS ?= "0x200000"

# vek-280-surround-view-dms Serial Console
SERIAL_CONSOLES ?= "115200;ttyAMA0"
YAML_SERIAL_CONSOLE_BAUDRATE ?= "115200"

# Set DDR Base address for u-boot-xlnx-scr variables
DDR_BASEADDR ?= "0x00000000"
SKIP_APPEND_BASEADDR ?= "0"

# Required generic machine inclusion
require conf/machine/versal-ai-edge-generic.conf

# Topology for device tree and /etc entries
SV_DMS_TOPOLOGY ?= "TOPOLOGY_SURROUND_VIEW_DMS"
SV_DMS_TOPOLOGY_SHORT ?= "surround_view_dms"
SV_DMS_BOARD ?= "BOARD_VEK280"
SV_DMS_BOARD_SHORT ?= "vek280"
SV_DMS_USE_DUMMY_DISPLAY ?= "1"
SV_DMS_USE_PCIE_CAPTURE_PIPE ?= "1"

QB_MEM = "-m 12G"
QEMU_HW_DTB_PS = "${QEMU_HW_DTB_PATH}/board-versal-ps-vek280.dtb"
QEMU_HW_DTB_PMC = "${QEMU_HW_DTB_PATH}/board-versal-pmc-virt.dtb"

# Add system XSA                                                                      
HDF_MACHINE = "vek-280-surround-view-dms"

HDF_EXT = "xsa"
HDF_BASE = "https://"
HDF_PATH = "mkmartifactory.amd.com:8443/artifactory/SW-AutomotiveDevOps-DEV-LOCAL/ERICA-H/hardware/vek280_surround_view_dms_2024_12_04_e5957860c9c699198049106157004071b053085d.xsa"
SRC_URI[sha256sum] = "f9ad30d2d76c4e5078e41e1b17a2ddbcaf503a6ec9450a23998ee76adf3d3c02"

DMS_DPU_FIRMWARE = "https://mkmartifactory.amd.com:8443/artifactory/SW-AutomotiveDevOps-DEV-LOCAL/ERICA-H/hardware/vek280_surround_view_dms_2024_12_04_e5957860c9c699198049106157004071b053085d.tar.gz"
DMS_DPU_FIRMWARE_CHECKSUM = "8c078f3d3f410e98491cf9dc69c9854a0ced32a67e07ba5d00b837a51113b6a2"

IMAGE_INSTALL:append = " dms-dpu-firmware dms-dpu-firmware-ptest"

#### No additional settings should be after the Postamble
#### Postamble
PACKAGE_EXTRA_ARCHS:append = "${@['', ' vek_280_surround_view_dms']['vek-280-surround-view-dms' != '${MACHINE}']}"
```
