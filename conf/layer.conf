## conf/machine/vek280-svai-rgbir-vxp3.conf
```bitbake
#@TYPE: Machine
#@NAME: vek-280-svai-rgbir-vxp3
#@DESCRIPTION: Machine configuration for the vek-280-svai-rgbir-vxp3 board.

#### Preamble
MACHINEOVERRIDES =. "${@['', 'vek-280-svai-rgbir-vxp3:']['vek-280-svai-rgbir-vxp3' !='${MACHINE}']}"
#### Regular settings follow

# Yocto device-tree variables
YAML_CONSOLE_DEVICE_CONFIG:pn-device-tree ?= "CIPS_0_pspmc_0_psv_sbsauart_0"
YAML_MAIN_MEMORY_CONFIG:pn-device-tree ?= "C0_DDR_LOW0X2"
DT_PADDING_SIZE:pn-device-tree ?= "0x1000"
DTC_FLAGS:pn-device-tree ?= "-@"
YAML_DT_BOARD_FLAGS ?= "{BOARD template}"

# Yocto u-boot-xlnx variables
UBOOT_MACHINE ?= "xilinx_versal_virt_defconfig"

# Yocto arm-trusted-firmware(TF-A) variables
ATF_CONSOLE_DEFAULT ?= "pl011"
TFA_BL33_LOAD ?= "0x8000000"

# Yocto PLM variables
YAML_SERIAL_CONSOLE_STDIN:pn-plm-firmware ?= "CIPS_0_pspmc_0_psv_sbsauart_0"
YAML_SERIAL_CONSOLE_STDOUT:pn-plm-firmware ?= "CIPS_0_pspmc_0_psv_sbsauart_0"

# Yocto KERNEL Variables
UBOOT_ENTRYPOINT  ?= "0x200000"
UBOOT_LOADADDRESS ?= "0x200000"

# vek-280-surround-view-dms Serial Console
SERIAL_CONSOLES ?= "115200;ttyAMA0"
YAML_SERIAL_CONSOLE_BAUDRATE ?= "115200"

# Set DDR Base address for u-boot-xlnx-scr variables
DDR_BASEADDR ?= "0x00000000"
SKIP_APPEND_BASEADDR ?= "0"

# Required generic machine inclusion
require conf/machine/versal-ai-edge-generic.conf

# Topology for device tree and /etc entries
SV_DMS_TOPOLOGY ?= "TOPOLOGY_SVAI_RGBIR_VXP3"
SV_DMS_TOPOLOGY_SHORT ?= "svai_rgbir_vxp3"
SV_DMS_BOARD ?= "BOARD_VEK280"
SV_DMS_BOARD_SHORT ?= "vek280"
SV_DMS_USE_DUMMY_DISPLAY ?= "1"
SV_DMS_USE_PCIE_CAPTURE_PIPE ?= "1"

QB_MEM = "-m 12G"
QEMU_HW_DTB_PS = "${QEMU_HW_DTB_PATH}/board-versal-ps-vek280.dtb"
QEMU_HW_DTB_PMC = "${QEMU_HW_DTB_PATH}/board-versal-pmc-virt.dtb"

# Add system XSA                                                                      
HDF_MACHINE = "vek-280-svai-rgbir-vpx3"

HDF_EXT = "xsa"
HDF_BASE = "https://"
HDF_PATH = "mkmartifactory.amd.com:8443/artifactory/SW-AutomotiveDevOps-DEV-LOCAL/ERICA-H/hardware/vek280_surround_view_rgbir_2025_12_08_3701f8e106db8e230a72807a1fb1a44aba0d5281.xsa"
SRC_URI[sha256sum] = "4c11d920a3b3a73aff61b24fb93f77e60f5bca51b6c94a790babe62c9420852d"

DMS_DPU_FIRMWARE = "https://mkmartifactory.amd.com:8443/artifactory/SW-AutomotiveDevOps-DEV-LOCAL/ERICA-H/hardware/vek280_surround_view_rgbir_2025_12_08_3701f8e106db8e230a72807a1fb1a44aba0d5281.tar.gz"
DMS_DPU_FIRMWARE_CHECKSUM = "989179f2e6c63e3fa40bd56f27f3b8cc1ca9807f379ad362022097077090ba11"

IMAGE_INSTALL:append = " dms-dpu-firmware dms-dpu-firmware-ptest"

#### No additional settings should be after the Postamble
#### Postamble
PACKAGE_EXTRA_ARCHS:append = "${@['', ' vek_280_svai_rgbir_vxp3']['vek-280-svai-rgbir-vxp3' != '${MACHINE}']}"
```

## conf/machine/vek280-svai-rgbir.conf
```bitbake
#@TYPE: Machine
#@NAME: vek-280-svai-rgbir
#@DESCRIPTION: Machine configuration for the vek-280-svai-rgbir board.

#### Preamble
MACHINEOVERRIDES =. "${@['', 'vek-280-svai-rgbir:']['vek-280-svai-rgbir' !='${MACHINE}']}"
#### Regular settings follow

# Yocto device-tree variables
YAML_CONSOLE_DEVICE_CONFIG:pn-device-tree ?= "CIPS_0_pspmc_0_psv_sbsauart_0"
YAML_MAIN_MEMORY_CONFIG:pn-device-tree ?= "C0_DDR_LOW0X2"
DT_PADDING_SIZE:pn-device-tree ?= "0x1000"
DTC_FLAGS:pn-device-tree ?= "-@"
YAML_DT_BOARD_FLAGS ?= "{BOARD template}"

# Yocto u-boot-xlnx variables
UBOOT_MACHINE ?= "xilinx_versal_virt_defconfig"

# Yocto arm-trusted-firmware(TF-A) variables
ATF_CONSOLE_DEFAULT ?= "pl011"
TFA_BL33_LOAD ?= "0x8000000"

# Yocto PLM variables
YAML_SERIAL_CONSOLE_STDIN:pn-plm-firmware ?= "CIPS_0_pspmc_0_psv_sbsauart_0"
YAML_SERIAL_CONSOLE_STDOUT:pn-plm-firmware ?= "CIPS_0_pspmc_0_psv_sbsauart_0"

# Yocto KERNEL Variables
UBOOT_ENTRYPOINT  ?= "0x200000"
UBOOT_LOADADDRESS ?= "0x200000"

# vek-280-surround-view-dms Serial Console
SERIAL_CONSOLES ?= "115200;ttyAMA0"
YAML_SERIAL_CONSOLE_BAUDRATE ?= "115200"

# Set DDR Base address for u-boot-xlnx-scr variables
DDR_BASEADDR ?= "0x00000000"
SKIP_APPEND_BASEADDR ?= "0"

# Required generic machine inclusion
require conf/machine/versal-ai-edge-generic.conf

# Topology for device tree and /etc entries
SV_DMS_TOPOLOGY ?= "TOPOLOGY_SVAI_RGBIR"
SV_DMS_TOPOLOGY_SHORT ?= "svai_rgbir"
SV_DMS_BOARD ?= "BOARD_VEK280"
SV_DMS_BOARD_SHORT ?= "vek280"
SV_DMS_USE_DUMMY_DISPLAY ?= "1"
SV_DMS_USE_PCIE_CAPTURE_PIPE ?= "1"

QB_MEM = "-m 12G"
QEMU_HW_DTB_PS = "${QEMU_HW_DTB_PATH}/board-versal-ps-vek280.dtb"
QEMU_HW_DTB_PMC = "${QEMU_HW_DTB_PATH}/board-versal-pmc-virt.dtb"

# Add system XSA                                                                      
HDF_MACHINE = "vek-280-svai-rgbir"

HDF_EXT = "xsa"
HDF_BASE = "https://"
HDF_PATH = "mkmartifactory.amd.com:8443/artifactory/SW-AutomotiveDevOps-DEV-LOCAL/ERICA-H/hardware/vek280_surround_view_rgbir_2025_02_12_fda96c884b6494679eadb034eddb53bf635dc792.xsa"
SRC_URI[sha256sum] = "e5f09363abbe2042f898c2d9fa68e1736a84037a0e9869148d6b8797d85ce076"

DMS_DPU_FIRMWARE = "https://mkmartifactory.amd.com:8443/artifactory/SW-AutomotiveDevOps-DEV-LOCAL/ERICA-H/hardware/vek280_surround_view_rgbir_2025_02_12_fda96c884b6494679eadb034eddb53bf635dc792.tar.gz"
DMS_DPU_FIRMWARE_CHECKSUM = "b8cb668e0d6ee9d06728892368a9ac265ccee618106e954dec737dca8987fd47"

IMAGE_INSTALL:append = " dms-dpu-firmware dms-dpu-firmware-ptest"

#### No additional settings should be after the Postamble
#### Postamble
PACKAGE_EXTRA_ARCHS:append = "${@['', ' vek_280_svai_rgbirms']['vek-280-svai-rgbir' != '${MACHINE}']}"
```

## conf/machine/vek385-base-revb.conf
```bitbake
#@TYPE: Machine
#@NAME: vek385-base-revb
#@DESCRIPTION: Machine configuration for the vek385-base-revb boards.

BBMULTICONFIG += "vek385-base-revb-cortexr52-1-baremetal vek385-base-revb-microblaze-pmc"
MACHINEOVERRIDES .= ":versal-2ve-2vm-vek385-sdt-seg"

#### Preamble
MACHINEOVERRIDES =. "${@['', 'vek385-base-revb:']['vek385-base-revb' !='${MACHINE}']}"
#### Regular settings follow
TUNEFILE[microblaze-pmc] = "conf/machine/include/vek385-base-revb/microblaze.inc"

# Platform Loader and Manager
PLM_DEPENDS = ""
PLM_MCDEPENDS = "mc::vek385-base-revb-microblaze-pmc:plm-firmware:do_deploy"
PLM_DEPLOY_DIR = "${TMPDIR}-vek385-base-revb-microblaze-pmc/deploy/images/${MACHINE}"

# Set the default (linux) domain device tree
CONFIG_DTFILE_DIR := "${@bb.utils.which(d.getVar('BBPATH'), 'conf/dts/vek385-base-revb')}"
CONFIG_DTFILE ?= "${CONFIG_DTFILE_DIR}/cortexa78-linux.dts"
CONFIG_DTFILE[vardepsexclude] += "CONFIG_DTFILE_DIR"

# Yocto arm-trusted-firmware(TF-A) variables
TFA_CONSOLE ?= "pl011_1"
TFA_BL33_LOAD ?= "0x40000000"

# Yocto OP-TEE variables
OPTEE_CONSOLE ?= "1"

# Set DDR Base address for u-boot-xlnx-scr variables
DDR_BASEADDR ?= "0x0"
SKIP_APPEND_BASEADDR ?= "1"

# Yocto KERNEL Variables
UBOOT_ENTRYPOINT  ?= "0x20200000"
UBOOT_LOADADDRESS ?= "0x20200000"

# Yocto MACHINE_FEATURES Variable
MACHINE_FEATURES += "vcu2 malig78ae"

# Required generic machine inclusion
require conf/machine/versal-2ve-2vm-generic.conf

# This is an 'SDT' based BSP
XILINX_WITH_ESW = "sdt"

# Original SDT artifacts URL
SDT_URI = "https://mkmartifactory.amd.com:8443/artifactory/SW-AutomotiveDevOps-DEV-LOCAL/ERICA-H/hardware/vek385_ecp_2026_02_09_af40a4d671d17bfd3f687fb287c493c8e07438d9_mod.tar.gz"
SDT_URI[S] = "${WORKDIR}/sdt_artifacts"
SDT_URI[sha256sum] = "80150c95853b7d3be5bc49e8ce7ac3b27ad3bbd51a897d61cdc6e9ca4976bda0"

# Set the system device trees
SYSTEM_DTFILE_DEPENDS = "sdt-artifacts"
SYSTEM_DTFILE_DIR = "${RECIPE_SYSROOT}${datadir}/sdt/${MACHINE}"
SYSTEM_DTFILE = "${SYSTEM_DTFILE_DIR}/system-top.dts"

# Load the dynamic machine features
include conf/machine/include/vek385-base-revb/${BB_CURRENT_MC}-features.conf
LIBXIL_CONFIG = "conf/machine/include/vek385-base-revb/${BB_CURRENT_MC}-libxil.conf"

# Versal PDI
PDI_PATH_DEPENDS = "sdt-artifacts"
PDI_PATH_DIR = "${RECIPE_SYSROOT}${datadir}/sdt/${MACHINE}"
PDI_PATH = "${PDI_PATH_DIR}/versal_hexcam_20232_1_boot.pdi"

# Update bootbin to use proper device tree
BIF_PARTITION_IMAGE[device-tree] = "${RECIPE_SYSROOT}/boot/devicetree/${@os.path.basename(d.getVar('CONFIG_DTFILE').replace('.dts', '.dtb'))}"

# Remap boot files to ensure the right device tree is listed first
IMAGE_BOOT_FILES =+ "devicetree/${@os.path.basename(d.getVar('CONFIG_DTFILE').replace('.dts', '.dtb'))}"

#### No additional settings should be after the Postamble
#### Postamble
PACKAGE_EXTRA_ARCHS:append = "${@['', ' vek385_base_revb']['vek385-base-revb' != '${MACHINE}']}"
```

## conf/machine/vek385-imx623-sentry.conf
```bitbake
#@TYPE: Machine
#@NAME: vek385-imx623-sentry
#@DESCRIPTION: Machine configuration for the vek385-imx623-sentry boards.


BBMULTICONFIG += "vek385-imx623-sentry-cortexr52-1-baremetal vek385-imx623-sentry-microblaze-pmc"
MACHINEOVERRIDES .= ":versal-2ve-2vm-vek385-sdt-seg"

#### Preamble
MACHINEOVERRIDES =. "${@['', 'vek385-imx623-sentry:']['vek385-imx623-sentry' !='${MACHINE}']}"
#### Regular settings follow
TUNEFILE[microblaze-pmc] = "conf/machine/include/vek385-imx623-sentry/microblaze.inc"

# Platform Loader and Manager
PLM_DEPENDS = ""
PLM_MCDEPENDS = "mc::vek385-imx623-sentry-microblaze-pmc:plm-firmware:do_deploy"
PLM_DEPLOY_DIR = "${TMPDIR}-vek385-imx623-sentry-microblaze-pmc/deploy/images/${MACHINE}"

# Set the default (linux) domain device tree
CONFIG_DTFILE_DIR := "${@bb.utils.which(d.getVar('BBPATH'), 'conf/dts/vek385-imx623-sentry')}"
CONFIG_DTFILE ?= "${CONFIG_DTFILE_DIR}/cortexa78-linux.dts"
CONFIG_DTFILE[vardepsexclude] += "CONFIG_DTFILE_DIR"

DTB_FILE_PATH ?= "${RECIPE_SYSROOT}/boot/devicetree/${@os.path.basename(d.getVar('CONFIG_DTFILE').replace('.dts', '.dtb'))}"

# Serial Console Settings
SERIAL_CONSOLES ?= "115200;ttyAMA0"

# Yocto arm-trusted-firmware(TF-A) variables
TFA_CONSOLE ?= "pl011_1"
TFA_BL33_LOAD ?= "0x40000000"

# Yocto OP-TEE variables
OPTEE_CONSOLE ?= "1"

# Yocto u-boot-xlnx variables

# Set DDR Base address for u-boot-xlnx-scr variables
DDR_BASEADDR ?= "0x0"
SKIP_APPEND_BASEADDR ?= "1"

# Yocto KERNEL Variables
UBOOT_ENTRYPOINT ?= "0x20200000"
UBOOT_LOADADDRESS ?= "0x20200000"

# Yocto MACHINE_FEATURES Variable
MACHINE_FEATURES += "vcu2 malig78ae efi"

# Required generic machine inclusion
require conf/machine/versal-2ve-2vm-generic.conf

# QEMU Memory Configuration
QB_MEM = "-machine dynamic-mem=on -device amd-ddr-memory,address=0x800000000,size=0x80000000"

# This is an 'SDT' based BSP
XILINX_WITH_ESW = "sdt"

# Original SDT artifacts URL
SDT_URI = "https://mkmartifactory.amd.com/artifactory/SW-AutomotiveDevOps-DEV-LOCAL/ERICA-H/hardware//vek385_sentry_imx623_2026_10_20_6917900f2e30e29d83e7df44e5a948ff4b794731.tar.gz"
SDT_URI[S] = "${WORKDIR}/sdt_artifacts"
SDT_URI[sha256sum] = "9c1ea351f0750cc112637be43f387c942ee30bd7b74ffc28dd41f9a9eb877f23"

# Set the system device trees
SYSTEM_DTFILE_DEPENDS = "sdt-artifacts"
SYSTEM_DTFILE_DIR = "${RECIPE_SYSROOT}${datadir}/sdt/${MACHINE}"
SYSTEM_DTFILE = "${SYSTEM_DTFILE_DIR}/system-top.dts"

# Load the dynamic machine features
include conf/machine/include/vek385-imx623-sentry/${BB_CURRENT_MC}-features.conf
LIBXIL_CONFIG = "conf/machine/include/vek385-imx623-sentry/${BB_CURRENT_MC}-libxil.conf"

# PDI variables
PDI_PATH_DEPENDS = "sdt-artifacts"
PDI_PATH_DIR = "${RECIPE_SYSROOT}${datadir}/sdt/${MACHINE}"
PDI_PATH = "${PDI_PATH_DIR}/vpl_gen_fixed_boot.pdi"

# Primary Bootmode value
DEFAULT_HW_BOOT_MODE = "8"

# Update bootbin to use proper device tree
BIF_PARTITION_IMAGE[device-tree] = "${DTB_FILE_PATH}"

# Remap boot files to ensure the right device tree is listed first
IMAGE_BOOT_FILES =+ "devicetree/${@os.path.basename(d.getVar('CONFIG_DTFILE').replace('.dts', '.dtb'))}"

#### No additional settings should be after the Postamble
#### Postamble
PACKAGE_EXTRA_ARCHS:append = "${@['', ' vek385_imx623_sentry']['vek385-imx623-sentry' != '${MACHINE}']}"
```
