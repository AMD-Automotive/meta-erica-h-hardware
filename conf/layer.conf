## conf/machine/5050a-dms.conf
```bitbake
#@TYPE: Machine
#@NAME: 5050a-dms
#@DESCRIPTION: Machine configuration for the 5050a-dms boards.

#### Preamble
MACHINEOVERRIDES =. "${@['', '5050a-dms:']['5050a-dms' !='${MACHINE}']}"
#### Regular settings follow

# Yocto device-tree variables
YAML_CONSOLE_DEVICE_CONFIG:pn-device-tree ?= "CIPS_0_pspmc_0_psv_sbsauart_0"
YAML_MAIN_MEMORY_CONFIG:pn-device-tree ?= "C0_DDR_LOW0"
DT_PADDING_SIZE:pn-device-tree ?= "0x1000"
DTC_FLAGS:pn-device-tree ?= "-@"
YAML_DT_BOARD_FLAGS ?= "{BOARD template}"

# Yocto u-boot-xlnx variables
UBOOT_MACHINE ?= "xilinx_versal_virt_defconfig"

# Yocto arm-trusted-firmware(TF-A) variables
ATF_CONSOLE_DEFAULT ?= "pl011"
TFA_BL33_LOAD ?= "0x8000000"

# Yocto PLM variables
YAML_SERIAL_CONSOLE_STDIN:pn-plm-firmware ?= "CIPS_0_pspmc_0_psv_sbsauart_0"
YAML_SERIAL_CONSOLE_STDOUT:pn-plm-firmware ?= "CIPS_0_pspmc_0_psv_sbsauart_0"

# Yocto KERNEL Variables
UBOOT_ENTRYPOINT  ?= "0x200000"
UBOOT_LOADADDRESS ?= "0x200000"

# 5050a-versal Serial Console
SERIAL_CONSOLES ?= "115200;ttyAMA0"
YAML_SERIAL_CONSOLE_BAUDRATE ?= "115200"

# Set DDR Base address for u-boot-xlnx-scr variables
DDR_BASEADDR ?= "0x00000000"
SKIP_APPEND_BASEADDR ?= "0"

# Required generic machine inclusion
require conf/machine/versal-ai-edge-generic.conf

# Topology for device tree and /etc entries
SV_DMS_TOPOLOGY ?= "TOPOLOGY_DMS"
SV_DMS_TOPOLOGY_SHORT ?= "5050a_dms"
SV_DMS_BOARD ?= "BOARD_5050A"
SV_DMS_BOARD_SHORT ?= "5050a"
SV_DMS_USE_DUMMY_DISPLAY ?= "1"
SV_DMS_USE_PCIE_CAPTURE_PIPE ?= "1"

QB_MEM = "-m 8G"
QEMU_HW_DTB_PS = "${QEMU_HW_DTB_PATH}/board-versal-ps-vek280.dtb"
QEMU_HW_DTB_PMC = "${QEMU_HW_DTB_PATH}/board-versal-pmc-virt.dtb"

# Add system XSA
HDF_MACHINE = "5050a-dms"
HDF_EXT = "xsa"
HDF_BASE = "https://"
HDF_PATH = "mkmartifactory.amd.com:8443/artifactory/SW-AutomotiveDevOps-DEV-LOCAL/ERICA-H/hardware/5050a_dms_2025_02_06_7f87d69946358863509fe80965df6c68acd5facf.xsa"
SRC_URI[sha256sum] = "b586782f6e49f43a755f5ff773aa606ff4272e4bf34a4ad07ae460ae5aeb464f"

DMS_DPU_FIRMWARE = "https://mkmartifactory.amd.com:8443/artifactory/SW-AutomotiveDevOps-DEV-LOCAL/ERICA-H/hardware/5050a_dms_2025_02_06_7f87d69946358863509fe80965df6c68acd5facf.tar.gz"
DMS_DPU_FIRMWARE_CHECKSUM = "e26c9abea9e55e11ac80e6005efcc84f6f0099914711ec0c33c36d139983cecb"

IMAGE_INSTALL:append = " dms-dpu-firmware dms-dpu-firmware-ptest"

#### No additional settings should be after the Postamble
#### Postamble
PACKAGE_EXTRA_ARCHS:append = "${@['', ' 5050a_dms']['5050a-dms' != '${MACHINE}']}"
```

## conf/machine/5050a-dual-rank.conf
```bitbake
#@TYPE: Machine
#@NAME: 5050a-dual-versal
#@DESCRIPTION: Machine configuration for the 5050a-dual-versal boards.

#### Preamble
MACHINEOVERRIDES =. "${@['', '5050a-dual:']['5050a-dual' !='${MACHINE}']}"
#### Regular settings follow

# Yocto device-tree variables
YAML_CONSOLE_DEVICE_CONFIG:pn-device-tree ?= "blp_cips_pspmc_0_psv_sbsauart_0"
YAML_MAIN_MEMORY_CONFIG:pn-device-tree ?= "C0_DDR_LOW0"
DT_PADDING_SIZE:pn-device-tree ?= "0x1000"
DTC_FLAGS:pn-device-tree ?= "-@"
YAML_DT_BOARD_FLAGS ?= "{BOARD template}"

# Yocto u-boot-xlnx variables
UBOOT_MACHINE ?= "xilinx_versal_virt_defconfig"

# Yocto arm-trusted-firmware(TF-A) variables
ATF_CONSOLE_DEFAULT ?= "pl011"
TFA_BL33_LOAD ?= "0x8000000"

# Yocto PLM variables
YAML_SERIAL_CONSOLE_STDIN:pn-plm-firmware ?= "blp_cips_pspmc_0_psv_sbsauart_0"
YAML_SERIAL_CONSOLE_STDOUT:pn-plm-firmware ?= "blp_cips_pspmc_0_psv_sbsauart_0"

# Yocto KERNEL Variables
UBOOT_ENTRYPOINT  ?= "0x200000"
UBOOT_LOADADDRESS ?= "0x200000"

# 5050a-dual-versal Serial Console
SERIAL_CONSOLES ?= "115200;ttyAMA0"
YAML_SERIAL_CONSOLE_BAUDRATE ?= "115200"

# Set DDR Base address for u-boot-xlnx-scr variables
DDR_BASEADDR ?= "0x00000000"
SKIP_APPEND_BASEADDR ?= "0"

# Required generic machine inclusion
require conf/machine/versal-ai-edge-generic.conf

# Topology for device tree and /etc entries
SV_DMS_TOPOLOGY ?= "TOPOLOGY_5050A_BRINGUP"
SV_DMS_TOPOLOGY_SHORT ?= "5050a_bringup"
SV_DMS_BOARD ?= "BOARD_5050A"
SV_DMS_BOARD_SHORT ?= "5050a"

# Add system XSA
HDF_MACHINE = "5050a-dual"
HDF_EXT = "xsa"
HDF_BASE = "file://"
HDF_PATH = "/home/build/work/dual_24.2.xsa"


# We dont have DPU/AIE firmware just yet
BBMASK += "/meta-erica-h/recipes-bsp/dms-dpu-firmware/dms-dpu-firmware.bb"
BBMASK += "/meta-erica-h/recipes-bsp/aie-image-cdo/aie-image-cdo.bb"


#### No additional settings should be after the Postamble
#### Postamble
PACKAGE_EXTRA_ARCHS:append = "${@['', ' 5050a_dual']['5050a-dual' != '${MACHINE}']}"
```

## conf/machine/5050a-rgbir.conf
```bitbake
#@TYPE: Machine
#@NAME: 5050a-rgbir
#@DESCRIPTION: Machine configuration for the 5050a-versal boards.

#### Preamble
MACHINEOVERRIDES =. "${@['', '5050a-rgbir:']['5050a-rgbir' !='${MACHINE}']}"
#### Regular settings follow

# Yocto device-tree variables
YAML_CONSOLE_DEVICE_CONFIG:pn-device-tree ?= "CIPS_0_pspmc_0_psv_sbsauart_0"
YAML_MAIN_MEMORY_CONFIG:pn-device-tree ?= "C0_DDR_LOW0"
DT_PADDING_SIZE:pn-device-tree ?= "0x1000"
DTC_FLAGS:pn-device-tree ?= "-@"
YAML_DT_BOARD_FLAGS ?= "{BOARD template}"

# Yocto u-boot-xlnx variables
UBOOT_MACHINE ?= "xilinx_versal_virt_defconfig"

# Yocto arm-trusted-firmware(TF-A) variables
ATF_CONSOLE_DEFAULT ?= "pl011"
TFA_BL33_LOAD ?= "0x8000000"

# Yocto PLM variables
YAML_SERIAL_CONSOLE_STDIN:pn-plm-firmware ?= "CIPS_0_pspmc_0_psv_sbsauart_0"
YAML_SERIAL_CONSOLE_STDOUT:pn-plm-firmware ?= "CIPS_0_pspmc_0_psv_sbsauart_0"

# Yocto KERNEL Variables
UBOOT_ENTRYPOINT  ?= "0x200000"
UBOOT_LOADADDRESS ?= "0x200000"

# 5050a-versal Serial Console
SERIAL_CONSOLES ?= "115200;ttyAMA0"
YAML_SERIAL_CONSOLE_BAUDRATE ?= "115200"

# Set DDR Base address for u-boot-xlnx-scr variables
DDR_BASEADDR ?= "0x00000000"
SKIP_APPEND_BASEADDR ?= "0"

# Required generic machine inclusion
require conf/machine/versal-ai-edge-generic.conf

# Topology for device tree and /etc entries
SV_DMS_TOPOLOGY ?= "TOPOLOGY_RGBIR"
SV_DMS_TOPOLOGY_SHORT ?= "5050a_rgbir"
SV_DMS_BOARD ?= "BOARD_5050A"
SV_DMS_BOARD_SHORT ?= "5050a"
SV_DMS_USE_DUMMY_DISPLAY ?= "1"
SV_DMS_USE_PCIE_CAPTURE_PIPE ?= "1"

QB_MEM = "-m 8G"
QEMU_HW_DTB_PS = "${QEMU_HW_DTB_PATH}/board-versal-ps-vek280.dtb"
QEMU_HW_DTB_PMC = "${QEMU_HW_DTB_PATH}/board-versal-pmc-virt.dtb"

# Add system XSA
HDF_MACHINE = "5050a-rgbir"
HDF_EXT = "xsa"
HDF_BASE = "https://"
HDF_PATH = "mkmartifactory.amd.com:8443/artifactory/SW-AutomotiveDevOps-DEV-LOCAL/ERICA-H/hardware/sapphire_5050a_rgbir_2025_03_17_ae7c62c7bfe3532f26e594472a1c6cca0205a3cb.xsa"
SRC_URI[sha256sum] = "94becd584889c0f4f2df3645a5d8ab137249f67f47fff13823980a2f2334f9f8"

DMS_DPU_FIRMWARE = "https://mkmartifactory.amd.com:8443/artifactory/SW-AutomotiveDevOps-DEV-LOCAL/ERICA-H/hardware/sapphire_5050a_rgbir_2025_03_17_ae7c62c7bfe3532f26e594472a1c6cca0205a3cb.tar.gz"
DMS_DPU_FIRMWARE_CHECKSUM = "c77954c8bb708d8a2a9bcced2f61173676143c3fbbc23678f501f4bc94cf4c21"

IMAGE_INSTALL:append = " dms-dpu-firmware dms-dpu-firmware-ptest"

#### No additional settings should be after the Postamble
#### Postamble
PACKAGE_EXTRA_ARCHS:append = "${@['', ' 5050a_rgbir']['5050a-rgbir' != '${MACHINE}']}"
```

## conf/machine/5050a-single-rank.conf
```bitbake
#@TYPE: Machine
#@NAME: 5050a-versal
#@DESCRIPTION: Machine configuration for the 5050a-versal boards.

#### Preamble
MACHINEOVERRIDES =. "${@['', '5050a-single:']['5050a-single' !='${MACHINE}']}"
#### Regular settings follow

# Yocto device-tree variables
YAML_CONSOLE_DEVICE_CONFIG:pn-device-tree ?= "blp_cips_pspmc_0_psv_sbsauart_0"
YAML_MAIN_MEMORY_CONFIG:pn-device-tree ?= "C0_DDR_LOW0"
DT_PADDING_SIZE:pn-device-tree ?= "0x1000"
DTC_FLAGS:pn-device-tree ?= "-@"
YAML_DT_BOARD_FLAGS ?= "{BOARD template}"

# Yocto u-boot-xlnx variables
UBOOT_MACHINE ?= "xilinx_versal_virt_defconfig"

# Yocto arm-trusted-firmware(TF-A) variables
ATF_CONSOLE_DEFAULT ?= "pl011"
TFA_BL33_LOAD ?= "0x8000000"

# Yocto PLM variables
YAML_SERIAL_CONSOLE_STDIN:pn-plm-firmware ?= "blp_cips_pspmc_0_psv_sbsauart_0"
YAML_SERIAL_CONSOLE_STDOUT:pn-plm-firmware ?= "blp_cips_pspmc_0_psv_sbsauart_0"

# Yocto KERNEL Variables
UBOOT_ENTRYPOINT  ?= "0x200000"
UBOOT_LOADADDRESS ?= "0x200000"

# 5050a-versal Serial Console
SERIAL_CONSOLES ?= "115200;ttyAMA0"
YAML_SERIAL_CONSOLE_BAUDRATE ?= "115200"

# Set DDR Base address for u-boot-xlnx-scr variables
DDR_BASEADDR ?= "0x00000000"
SKIP_APPEND_BASEADDR ?= "0"

# Required generic machine inclusion
require conf/machine/versal-ai-edge-generic.conf

# Topology for device tree and /etc entries
SV_DMS_TOPOLOGY ?= "TOPOLOGY_5050A_BRINGUP"
SV_DMS_TOPOLOGY_SHORT ?= "5050a_bringup"
SV_DMS_BOARD ?= "BOARD_5050A"
SV_DMS_BOARD_SHORT ?= "5050a"

# Add system XSA
HDF_MACHINE = "5050a-single"
HDF_EXT = "xsa"
HDF_BASE = "https://"
HDF_PATH = "mkmartifactory.amd.com:8443/artifactory/SW-AutomotiveDevOps-DEV-LOCAL/ERICA-H/hardware/5050a/5050a-qdma-cam-20232_2-2025_02_06.xsa"
SRC_URI[sha256sum] = "b780eb9522aca1728fa00223482fcebd5bc4fe4ab7f898c09424c8a644f670e8"

# We dont have DPU/AIE firmware just yet
BBMASK += "/meta-erica-h/recipes-bsp/dms-dpu-firmware/dms-dpu-firmware.bb"
BBMASK += "/meta-erica-h/recipes-bsp/aie-image-cdo/aie-image-cdo.bb"


#### No additional settings should be after the Postamble
#### Postamble
PACKAGE_EXTRA_ARCHS:append = "${@['', ' 5050a_single']['5050a-single' != '${MACHINE}']}"
```

## conf/machine/include/rave2-baseline-seg/rave2-baseline-seg-microblaze-riscv-asu-features.conf
```bitbake
MACHINE_FEATURES = "common csudma dcsub emacps gpiops iicps iomodule ipipsu mmidp rtcpsu spips uartpsv usbpsu video-common"
```

## conf/machine/include/rave2-ecp-2026-1/rave2-ecp-2026-1-cortexr52-4-baremetal-features.conf
```bitbake
MACHINE_FEATURES = "canfd cframe cfupmc common coresightps-dcc csudma dcsub emacps gpiops iic iicps ipipsu llfifo mmidp ospipsv rtcpsu scugic spips sysmonpsv trngpsx ttcps uartpsv ufspsxc video-common visp-ss zdma"
```

## conf/machine/include/rave2-imx623-sentry/rave2-imx623-sentry-cortexr52-1-baremetal-libxil.conf
```bitbake
PACKAGECONFIG[canfd] = "${RECIPE_SYSROOT}/usr/lib/libcanfd.a,,canfd,,"
PACKAGECONFIG[cframe] = "${RECIPE_SYSROOT}/usr/lib/libcframe.a,,cframe,,"
PACKAGECONFIG[cfupmc] = "${RECIPE_SYSROOT}/usr/lib/libcfupmc.a,,cfupmc,,"
PACKAGECONFIG[common] = "${RECIPE_SYSROOT}/usr/lib/libcommon.a,,common,,"
PACKAGECONFIG[coresightps-dcc] = "${RECIPE_SYSROOT}/usr/lib/libcoresightps_dcc.a,,coresightps-dcc,,"
PACKAGECONFIG[csi] = "${RECIPE_SYSROOT}/usr/lib/libcsi.a,,csi,,"
PACKAGECONFIG[csudma] = "${RECIPE_SYSROOT}/usr/lib/libcsudma.a,,csudma,,"
PACKAGECONFIG[dcsub] = "${RECIPE_SYSROOT}/usr/lib/libdcsub.a,,dcsub,,"
PACKAGECONFIG[emacps] = "${RECIPE_SYSROOT}/usr/lib/libemacps.a,,emacps,,"
PACKAGECONFIG[gpio] = "${RECIPE_SYSROOT}/usr/lib/libgpio.a,,gpio,,"
PACKAGECONFIG[gpiops] = "${RECIPE_SYSROOT}/usr/lib/libgpiops.a,,gpiops,,"
PACKAGECONFIG[i2srx] = "${RECIPE_SYSROOT}/usr/lib/libi2srx.a,,i2srx,,"
PACKAGECONFIG[i2stx] = "${RECIPE_SYSROOT}/usr/lib/libi2stx.a,,i2stx,,"
PACKAGECONFIG[iic] = "${RECIPE_SYSROOT}/usr/lib/libiic.a,,iic,,"
PACKAGECONFIG[iicps] = "${RECIPE_SYSROOT}/usr/lib/libiicps.a,,iicps,,"
PACKAGECONFIG[intc] = "${RECIPE_SYSROOT}/usr/lib/libintc.a,,intc,,"
PACKAGECONFIG[mipi-rx-phy] = "${RECIPE_SYSROOT}/usr/lib/libmipi_rx_phy.a,,mipi-rx-phy,,"
PACKAGECONFIG[mipicsiss] = "${RECIPE_SYSROOT}/usr/lib/libmipicsiss.a,,mipicsiss,,"
PACKAGECONFIG[mmidp] = "${RECIPE_SYSROOT}/usr/lib/libmmidp.a,,mmidp,,"
PACKAGECONFIG[ospipsv] = "${RECIPE_SYSROOT}/usr/lib/libospipsv.a,,ospipsv,,"
PACKAGECONFIG[rtcpsu] = "${RECIPE_SYSROOT}/usr/lib/librtcpsu.a,,rtcpsu,,"
PACKAGECONFIG[scugic] = "${RECIPE_SYSROOT}/usr/lib/libscugic.a,,scugic,,"
PACKAGECONFIG[spi] = "${RECIPE_SYSROOT}/usr/lib/libspi.a,,spi,,"
PACKAGECONFIG[spips] = "${RECIPE_SYSROOT}/usr/lib/libspips.a,,spips,,"
PACKAGECONFIG[sysmonpsv] = "${RECIPE_SYSROOT}/usr/lib/libsysmonpsv.a,,sysmonpsv,,"
PACKAGECONFIG[trngpsx] = "${RECIPE_SYSROOT}/usr/lib/libtrngpsx.a,,trngpsx,,"
PACKAGECONFIG[ttcps] = "${RECIPE_SYSROOT}/usr/lib/libttcps.a,,ttcps,,"
PACKAGECONFIG[uartlite] = "${RECIPE_SYSROOT}/usr/lib/libuartlite.a,,uartlite,,"
PACKAGECONFIG[uartpsv] = "${RECIPE_SYSROOT}/usr/lib/libuartpsv.a,,uartpsv,,"
PACKAGECONFIG[ufspsxc] = "${RECIPE_SYSROOT}/usr/lib/libufspsxc.a,,ufspsxc,,"
PACKAGECONFIG[usbpsu] = "${RECIPE_SYSROOT}/usr/lib/libusbpsu.a,,usbpsu,,"
PACKAGECONFIG[video-common] = "${RECIPE_SYSROOT}/usr/lib/libvideo_common.a,,video-common,,"
PACKAGECONFIG[zdma] = "${RECIPE_SYSROOT}/usr/lib/libzdma.a,,zdma,,"
```

## conf/machine/include/rave2-xylon-sentry/rave2-xylon-sentry-cortexr52-1-baremetal-features.conf
```bitbake
MACHINE_FEATURES = "canfd cframe cfupmc common coresightps-dcc csi csudma dcsub emacps gpio gpiops i2srx i2stx iic iicps intc mipi-rx-phy mipicsiss mmidp ospipsv rtcpsu scugic spi spips sysmonpsv trngpsx ttcps uartlite uartpsv ufspsxc usbpsu video-common zdma"
```

## conf/machine/include/sdt-5050a-svai/sdt-5050a-svai-microblaze-pmc-features.conf
```bitbake
MACHINE_FEATURES = "canfd cframe cfupmc common csi csudma dphy emacps gpio gpiops iicps iomodule ipipsu ospipsv rtcpsu sdps spips sysmonpsv tmr-inject tmr-manager trngpsv ttcps uartlite uartpsv usbpsu zdma"
```

## conf/machine/include/vek385-isp-2026-1/vek385-isp-2026-1-cortexr52-1-baremetal-features.conf
```bitbake
MACHINE_FEATURES = "canfd cframe cfupmc common coresightps-dcc csudma dcsub emacps gpio gpiops iic iicps ipipsu mmidp ospipsv rtcpsu scugic sysmonpsv trngpsx ttcps uartpsv ufspsxc usbpsu video-common visp-ss xdmapcie zdma"
```

## conf/machine/include/vek385-xylon-sentry/vek385-xylon-sentry-cortexr52-1-baremetal-features.conf
```bitbake
MACHINE_FEATURES = "canfd cframe cfupmc common coresightps-dcc csi csudma dcsub emacps gpio gpiops iicps intc ipipsu mipi-rx-phy mipicsiss mmidp ospipsv rtcpsu scugic sysmonpsv trngpsx ttcps uartpsv ufspsxc usbpsu video-common xdmapcie zdma"
```
