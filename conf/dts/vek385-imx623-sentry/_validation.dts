// Copyright © Advanced Micro Devices, Inc., or its affiliates. All rights reserved.
// SPDX-License-Identifier: MIT
// Contributors: JC
// Maintainer: JC

/dts-v1/;
/include/ "cortexa78-linux.dts"
/include/ "vek385-imx623-sentry.dtsi"
/include/ "vek385-imx623-sentry-vid-dma-rd.dtsi"
